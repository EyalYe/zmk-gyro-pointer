## Kconfig
```kconfig
DT_COMPAT_ZMK_MPU6050_INPUT := zmk,mpu6050-input

config ZMK_MPU6050_INPUT
    bool "MPU6050 gyro-to-pointer input driver"
    default $(dt_compat_enabled,$(DT_COMPAT_ZMK_MPU6050_INPUT))
    depends on INPUT
    help
      Polls an MPU6050 gyroscope through the Zephyr sensor API and
      reports relative pointer motion (air-mouse style).

if ZMK_MPU6050_INPUT

config ZMK_MPU6050_INPUT_INIT_PRIORITY
    int "MPU6050 input driver init priority"
    default 95
    help
      Must be higher (later) than SENSOR_INIT_PRIORITY so the MPU6050
      sensor device is ready before this driver starts polling it.

endif # ZMK_MPU6050_INPUT
```

## boards/shields/air_mouse/Kconfig.defconfig
```kconfig
if SHIELD_AIR_MOUSE

config I2C
    default y

config SENSOR
    default y

config MPU6050
    default y

config ZMK_POINTING
    default y

endif
```

## dts/bindings/input/zmk,mpu6050-input.yaml
```yaml
# dts/bindings/input/zmk,mpu6050-input.yaml
description: MPU6050 gyro-to-pointer glue
compatible: "zmk,mpu6050-input"

properties:
  sensor:
    type: phandle
    required: true
  poll-interval-ms:
    type: int
    default: 10
  scale-mult:
    type: int
    default: 1
    description: |
      Pointer counts per poll = gyro rate (milli-rad/s) * scale-mult / scale-div.
  scale-div:
    type: int
    default: 1
    description: |
      See scale-mult. The MPU6050's default +-250 deg/s full scale tops out
      around 4363 milli-rad/s, so e.g. scale-div 200 gives at most ~21
      counts per poll.
  layers:
    type: array
    required: false
    description: |
      If set, the gyro is only polled while at least one of these layers
      is active; on all other layers polling stops entirely (saves power
      and suppresses pointer motion). Omit to poll on every layer.
  swap-xy:
    type: boolean
  invert-x:
    type: boolean
  invert-y:
    type: boolean
```
